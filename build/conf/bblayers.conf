## build/conf/bblayers.conf
```bitbake
# POKY_BBLAYERS_CONF_VERSION is increased each time build/conf/bblayers.conf
# changes incompatibly
POKY_BBLAYERS_CONF_VERSION = "2"

BBPATH = "${TOPDIR}"
BBFILES ?= ""

ROOTDIR = "${TOPDIR}/../"

BBLAYERS ?= " \
  ${ROOTDIR}/repos/openembedded-core/meta \
  ${ROOTDIR}/repos/meta-yocto/meta-poky \
  ${ROOTDIR}/repos/meta-yocto/meta-yocto-bsp \
  ${ROOTDIR}/repos/meta-tegra \
  ${ROOTDIR}/repos/meta-ros/meta-ros2 \
  ${ROOTDIR}/repos/meta-ros/meta-ros-common \
  ${ROOTDIR}/repos/meta-ros/meta-ros2-humble \
  ${ROOTDIR}/repos/meta-openembedded/meta-oe \
  ${ROOTDIR}/repos/meta-openembedded/meta-python \
  ${ROOTDIR}/repos/meta-openembedded/meta-networking \
  ${ROOTDIR}/repos/meta-openembedded/meta-gnome \
  ${ROOTDIR}/repos/meta-openembedded/meta-multimedia \
  ${ROOTDIR}/layers/meta-distro \
  ${ROOTDIR}/layers/meta-overrides \
  "
```

## layers/meta-ar0234-camera/conf/layer.conf
```bitbake
# We have a conf and classes directory, add to BBPATH
BBPATH .= ":${LAYERDIR}"

# We have recipes-* directories, add to BBFILES
BBFILES += "${LAYERDIR}/recipes-*/*/*.bb \
            ${LAYERDIR}/recipes-*/*/*.bbappend"

BBFILE_COLLECTIONS += "meta-ar0234-camera"
BBFILE_PATTERN_meta-ar0234-camera = "^${LAYERDIR}/"
BBFILE_PRIORITY_meta-ar0234-camera = "6"

LAYERDEPENDS_meta-ar0234-camera = "tegra core"
LAYERSERIES_COMPAT_meta-ar0234-camera = "wrynose"
```

## layers/meta-distro/conf/distro/sapience.conf
```bitbake
# SHA version in os-release pkg
INHERIT += "superproject-version"
VERSION_SHA = "${@superproject_shortsha(d)}"

# rest of distro config

DISTRO = "sapience"
DISTRO_NAME = "Sapience Embedded Linux"
DISTRO_VERSION = "0.0.1+alpha"


SDK_VENDOR = "-sapiencesdk"


TCLIBC = "glibc"

# 'packagegroup-core-boot', 'kernel-module-af-packet' copied from poky's config
# https://git.yoctoproject.org/poky/tree/meta-poky/conf/distro/poky.conf
SAPIENCE_DEFAULT_EXTRA_RDEPENDS = "packagegroup-core-boot ntpdate"
SAPIENCE_DEFAULT_EXTRA_RRECOMMENDS = "kernel-module-af-packet"

DISTRO_EXTRA_RDEPENDS += "${SAPIENCE_DEFAULT_EXTRA_RDEPENDS}"
DISTRO_EXTRA_RRECOMMENDS += "${SAPIENCE_DEFAULT_EXTRA_RRECOMMENDS}"

DISTRO_FEATURES ?= "${DISTRO_FEATURES_DEFAULT} polkit systemd pam usrmerge opengl wayland x11 wifi"

INIT_MANAGER = "systemd"

VIRTUAL-RUNTIME_init_manager = "systemd"


# ros2 humble ships with v0.1.0 which does not work with python 3.12+ (https://stackoverflow.com/questions/77274572/multiqc-modulenotfounderror-no-module-named-imp)
PREFERRED_VERSION_libcamera = "0.5.2"
```

## layers/meta-overrides/conf/layer.conf
```bitbake
# We have a conf and classes directory, add to BBPATH
BBPATH .= ":${LAYERDIR}"

# We have recipes-* directories, add to BBFILES
BBFILES += "${LAYERDIR}/recipes-*/*/*.bb \
            ${LAYERDIR}/recipes-*/*/*.bbappend"

BBFILE_COLLECTIONS += "meta-overrides"
BBFILE_PATTERN_meta-overrides = "^${LAYERDIR}/"
BBFILE_PRIORITY_meta-overrides = "6"
# default priority: 6

LAYERDEPENDS_meta-overrides = "core"
LAYERSERIES_COMPAT_meta-overrides = "walnascar"
```
